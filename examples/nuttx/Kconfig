## examples/nuttx/Kconfig
```kconfig
config EXAMPLES_ZENOH_PICO_DEMO
    bool "Zenoh-Pico Demo Application"
    default n
    select ZENOH_PICO_NUTTX
    ---help---
      A simple demo that initializes the Zenoh-Pico library and prints the status.
```

## nuttx/Kconfig
```kconfig
config ZENOH_PICO_NUTTX
    bool "Zenoh-Pico NuttX Library"
    default y
    ---help---
        Enable the Zenoh-Pico communication library for NuttX.
        (This will trigger the CMake build of Zenoh-Pico with proper flags.)

if ZENOH_PICO_NUTTX

config Z_FEATURE_LINK_SERIAL
    bool "Enable Serial Transport"
    default y
    ---help---
        Enable serial (UART) transport support for Zenoh-Pico on NuttX.

config Z_FEATURE_LINK_TCP
    bool "Enable TCP Transport"
    default n
    ---help---
        TCP transport is not supported on this configuration.

config Z_FEATURE_LINK_UDP_UNICAST
    bool "Enable UDP Unicast Transport"
    default n

config Z_FEATURE_LINK_UDP_MULTICAST
    bool "Enable UDP Multicast Transport"
    default n

config Z_FEATURE_LINK_BLUETOOTH
    bool "Enable Bluetooth Transport"
    default n

config Z_FEATURE_RAWETH_TRANSPORT
    bool "Enable Raw Ethernet Transport"
    default n

endif
```
